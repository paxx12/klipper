## src/esp32c3/Kconfig
```kconfig
# Kconfig settings for ESP32-C3

if MACH_ESP32C3

config ESP32C3_SELECT
    bool
    default y
    select HAVE_GPIO
    select HAVE_CHIPID
    select HAVE_STRICT_TIMING

config BOARD_DIRECTORY
    string
    default "esp32c3"

config MCU
    string
    default "esp32c3"

config CLOCK_FREQ
    int
    default 16000000

config FLASH_SIZE
    hex
    default 0x400000

config FLASH_BOOT_ADDRESS
    hex
    default 0x0

config STACK_SIZE
    int
    default 8192


######################################################################
# Flash offset
######################################################################

choice
    prompt "Bootloader offset"
    config ESP32C3_FLASH_START_0000
        bool "No bootloader"
    config ESP32C3_FLASH_START_10000
        bool "16KiB bootloader (ESP-IDF)"
endchoice

config FLASH_APPLICATION_ADDRESS
    hex
    default 0x10000 if ESP32C3_FLASH_START_10000
    default 0x0


######################################################################
# Communication interface
######################################################################

choice
    prompt "Communication Interface"
    config ESP32C3_SERIAL_UART0
        bool "UART0 on GPIO20/GPIO21"
        select SERIAL
endchoice

endif
```
